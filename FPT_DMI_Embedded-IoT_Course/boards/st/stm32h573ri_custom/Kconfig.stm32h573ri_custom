## FPT_DMI_Embedded-IoT_Course/boards/st/stm32h573ri_custom/board.yml
```yaml
board:
  name: stm32h573ri_custom
  full_name: Custom STM32H573RIV6 (E-Desk)
  vendor: st
  socs:
    - name: stm32h573xx
```

## showcase/SmartLighting/boards/st/stm32h573ri_custom/stm32h573ri_custom_defconfig
```kconfig
CONFIG_SYS_CLOCK_HW_CYCLES_PER_SEC=250000000
CONFIG_CLOCK_CONTROL=y
CONFIG_SERIAL=y
CONFIG_UART_STM32=y
CONFIG_CONSOLE=y
CONFIG_UART_CONSOLE=y
CONFIG_GPIO=y
CONFIG_PINCTRL=y
CONFIG_ARM_MPU=y
CONFIG_FLASH=y
```
