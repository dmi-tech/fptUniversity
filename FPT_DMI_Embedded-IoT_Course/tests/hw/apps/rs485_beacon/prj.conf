## CMakeLists.txt
```
cmake_minimum_required(VERSION 3.20.0)
find_package(Zephyr REQUIRED HINTS $ENV{ZEPHYR_BASE})
project(example)
set(DRIVER_DIR ${CMAKE_CURRENT_LIST_DIR}/../../../../driver)
target_sources(app PRIVATE src/main.c)
target_include_directories(app PRIVATE
  ${DRIVER_DIR}/protocols/uart
  ${DRIVER_DIR}/protocols/rs485
)
target_sources(app PRIVATE
  ${DRIVER_DIR}/protocols/uart/driver_uart.c
  ${DRIVER_DIR}/protocols/rs485/driver_rs485.c
)
```

## prj.conf
```kconfig
CONFIG_PRINTK=y
CONFIG_CONSOLE=y
CONFIG_USE_SEGGER_RTT=y
CONFIG_RTT_CONSOLE=y
CONFIG_UART_CONSOLE=n
CONFIG_SERIAL=y
CONFIG_UART_INTERRUPT_DRIVEN=y
CONFIG_RING_BUFFER=y
CONFIG_GPIO=y
CONFIG_BOOTLOADER_MCUBOOT=y
CONFIG_STM32_ENABLE_DEBUG_SLEEP_STOP=y
```

## app.overlay
```dts
/ {
	zephyr,user {
		rs485-de-gpios = <&gpioc 3 GPIO_ACTIVE_HIGH>;
	};
};
```

## src/main.c
```c
/* RS485 beacon + echo: sends "BEACON n" twice a second and echoes what it receives, so the PC side
 * can check TX and RX with no SWD (24 V on breaks SWD on this setup).
 */
#include <stdio.h>
#include <zephyr/kernel.h>
#include <zephyr/sys/printk.h>

#include "driver_rs485.h"

int main(void)
{
	uint8_t buf[64];
	char msg[32];
	unsigned int n = 0;
	int ret = driver_rs485_init(9600);

	printk("rs485 init=%d\n", ret);
	if (ret < 0) {
		return 0;
	}
	while (1) {
		int len = driver_rs485_receive_frame(buf, sizeof(buf), 20, K_MSEC(500));

		if (len > 0) {
			driver_rs485_print("ECHO: ");
			driver_rs485_send(buf, len);
		}
		snprintf(msg, sizeof(msg), "BEACON %u\r\n", n++);
		driver_rs485_print(msg);
	}
	return 0;
}
```
