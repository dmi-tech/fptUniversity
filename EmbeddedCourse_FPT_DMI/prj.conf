## CMakeLists.txt
```
cmake_minimum_required(VERSION 3.20.0)
find_package(Zephyr REQUIRED HINTS $ENV{ZEPHYR_BASE})
project(EmbeddedCourse_FPT_DMI VERSION 1.0.0)

# Thư mục chứa toàn bộ driver của môn học
set(DRIVER_DIR ${CMAKE_CURRENT_SOURCE_DIR}/driver)

# 1. Thư mục chứa file .h. Mỗi driver cần thêm thư mục của nó
#    VÀ thư mục của driver mà nó phụ thuộc (xem README của driver).
target_include_directories(app PRIVATE
  src
  # TODO (Sinh viên): thêm thư mục header của driver, ví dụ:
  # ${DRIVER_DIR}/peripherals/gpio
)

# 2. Các file .c cần biên dịch.
target_sources(app PRIVATE
  src/main.c
  # TODO (Sinh viên): thêm file .c của driver, ví dụ:
  # ${DRIVER_DIR}/peripherals/gpio/driver_gpio.c
)
```

## west.yml
```
# west manifest for EmbeddedCourse_FPT_DMI.
#
#   west init -l --mf EmbeddedCourse_FPT_DMI/west.yml fptUniversity
#   (run from the directory that holds the fptUniversity clone)
#   west update
#
# Only the modules this course needs are fetched.
manifest:
  version: "1.2"

  remotes:
    - name: zephyrproject-rtos
      url-base: https://github.com/zephyrproject-rtos

  projects:
    - name: zephyr
      remote: zephyrproject-rtos
      revision: v4.4.2
      import:
        name-allowlist:
          - cmsis
          - cmsis_6
          - hal_stm32
          - mbedtls
          - mcuboot
          - picolibc
          - segger
          - tf-psa-crypto
          - zcbor

  self:
    path: fptUniversity
```

## prj.conf
```kconfig
# --- Log qua SEGGER RTT (đọc bằng scripts/rtt.sh) ---
CONFIG_PRINTK=y
CONFIG_CONSOLE=y
CONFIG_USE_SEGGER_RTT=y
CONFIG_RTT_CONSOLE=y
# Không dùng UART làm console (UART5 dành riêng cho log của MCUboot)
CONFIG_UART_CONSOLE=n
# Giữ SWD truy cập được khi CPU ngủ (WFI), nếu không RTT/nạp sẽ mất kết nối
CONFIG_STM32_ENABLE_DEBUG_SLEEP_STOP=y

# --- Bắt buộc khi chạy sau MCUboot ---
CONFIG_BOOTLOADER_MCUBOOT=y

# TODO (Sinh viên): thêm Kconfig của driver ở đây, ví dụ:
# CONFIG_GPIO=y
```

## app.overlay
```dts
/*
 * app.overlay - mô tả phần cứng bổ sung cho ứng dụng của bạn.
 *
 * KHÔNG sửa file board (boards/st/stm32h573ri_custom/). Mọi thay đổi đặt ở đây.
 *
 * TODO (Sinh viên): dán đoạn overlay trong README của driver vào đây.
 * Hướng dẫn chung: driver/README.md mục 2 và 3.
 *
 * Lưu ý:
 *  - Dòng #include phải nằm ở ĐẦU file.
 *  - Một nhãn (label) chỉ được khai báo MỘT lần.
 *  - Hai driver không được dùng chung một chân (driver/README.md mục 3.3).
 */
```

## src/main.c
```c
#include <zephyr/kernel.h>
#include <zephyr/sys/printk.h>

int main(void)
{
	printk("\n============================================\n");
	printk("   EmbeddedCourse_FPT_DMI - Zephyr RTOS\n");
	printk("   Target: %s\n", CONFIG_BOARD_TARGET);
	printk("   Hello, World !!!\n");
	printk("============================================\n\n");

	while (1) {
		k_msleep(1000);
	}
	return 0;
}
```
